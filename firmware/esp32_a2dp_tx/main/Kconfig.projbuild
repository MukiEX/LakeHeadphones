## firmware/esp32_a2dp_tx/main/Kconfig.projbuild
```kconfig
menu "LakeHP 5.1 (ESP32 Bluetooth transmitter)"
    config LHP_I2S_BCLK
        int "I2S BCLK GPIO (from ESP32-S3)"
        default 26
    config LHP_I2S_WS
        int "I2S WS/LRCK GPIO (from ESP32-S3)"
        default 25
    config LHP_I2S_DIN
        int "I2S DATA GPIO (from ESP32-S3)"
        default 22
    config LHP_TX_TARGET_FILL
        int "Frames buffered between I2S and Bluetooth (48 per ms)"
        range 600 6000
        default 2400
        help
          2400 (50 ms) is robust. Around 1200 (25 ms) suits the S3's
          low-latency stereo mode if your Bluetooth link is clean.
    config LHP_SWAP_LR
        bool "Swap left/right (if your headset's channels come out reversed)"
        default n
    config LHP_BUTTON_GPIO
        int "Button GPIO (BOOT = 0). Hold 2 s to forget the headset and re-pair"
        default 0
    config LHP_LED_GPIO
        int "Status LED GPIO (-1 = none; many DevKits have one on 2)"
        default 2
    config LHP_HEADSET_NAME
        string "Only pair with a headset whose name contains this (empty = first audio device found)"
        default ""
    config LHP_DEVICE_NAME
        string "Bluetooth name of this transmitter"
        default "LakeHP 5.1"
endmenu
```

## firmware/esp32_a2dp_tx/sdkconfig.defaults
```kconfig
CONFIG_IDF_TARGET="esp32"
CONFIG_FREERTOS_HZ=1000
CONFIG_ESP_DEFAULT_CPU_FREQ_MHZ_240=y
CONFIG_COMPILER_OPTIMIZATION_PERF=y
# Classic Bluetooth only, Bluedroid, A2DP
CONFIG_BT_ENABLED=y
CONFIG_BTDM_CTRL_MODE_BLE_ONLY=n
CONFIG_BTDM_CTRL_MODE_BR_EDR_ONLY=y
CONFIG_BTDM_CTRL_MODE_BTDM=n
CONFIG_BT_BLUEDROID_ENABLED=y
CONFIG_BT_CLASSIC_ENABLED=y
CONFIG_BT_A2DP_ENABLE=y
CONFIG_BT_SSP_ENABLED=y
```

## firmware/esp32s3_usb_dsp/main/Kconfig.projbuild
```kconfig
menu "LakeHP 5.1 (ESP32-S3 USB + DSP)"
    choice LHP_I2S_ROLE
        prompt "I2S role"
        default LHP_I2S_MASTER
        config LHP_I2S_MASTER
            bool "Master (classic ESP32 A2DP transmitter)"
        config LHP_I2S_SLAVE
            bool "Slave (nRF5340 LE Audio transmitter drives the clocks)"
    endchoice
    choice LHP_I2S_SLOT
        prompt "I2S slot width"
        default LHP_I2S_SLOT_32
        config LHP_I2S_SLOT_32
            bool "32-bit slots (classic ESP32)"
        config LHP_I2S_SLOT_16
            bool "16-bit slots (nRF5340 nrf_audio default)"
    endchoice
    config LHP_TARGET_FILL
        int "Rooms mode: frames buffered in the device (latency vs. robustness)"
        range 1536 3072
        default 2560
        help
          48 frames = 1 ms. Must cover one 1024-frame DSP block plus jitter.
    config LHP_I2S_BCLK
        int "I2S BCLK GPIO"
        default 5
    config LHP_I2S_WS
        int "I2S WS/LRCK GPIO"
        default 6
    config LHP_I2S_DOUT
        int "I2S DATA out GPIO"
        default 7
    config LHP_BUTTON_GPIO
        int "Room button GPIO (BOOT = 0)"
        default 0
    config LHP_DEFAULT_ROOM
        int "Room at first boot (1 small, 2 medium, 3 large)"
        range 1 3
        default 1
endmenu
```
