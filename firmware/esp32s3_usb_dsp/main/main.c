/*
 * LakeHP 5.1 - ESP32-S3 half: USB 5.1 sound card + Dolby Headphone DSP.
 * Processed stereo goes out over I2S to the Bluetooth board:
 *   - classic ESP32 (firmware/esp32_a2dp_tx): S3 is I2S master, 32-bit slots
 *   - nRF5340 LE Audio (firmware/nrf5340_le_audio): S3 is I2S slave, 16-bit slots
 * (menuconfig "LakeHP 5.1", or sdkconfig.defaults.nrf5340)
 *
 *   core 0: TinyUSB task (+ USB pacing), I2S writer, button
 *   core 1: DSP task (lakehp engine)
 *
 * BOOT button: short press = next room (1/2/3 beeps), hold 2 s = low-latency
 * stereo on/off (2 high beeps = on; the room's beeps = back to rooms).
 */
#include <stdio.h>
#include <string.h>
#include "freertos/FreeRTOS.h"
#include "freertos/task.h"
#include "esp_log.h"
#include "esp_heap_caps.h"
#include "esp_timer.h"
#include "nvs_flash.h"
#include "nvs.h"
#include "driver/gpio.h"
#include "driver/i2s_std.h"
#include "esp_private/usb_phy.h"
#include "tusb.h"

#include "lakehp.h"
#include "dh_pipeline.h"
#include "usb_audio51.h"
#include "lakehp_filters.h"          /* generated by tools/extract_filters.py */

static const char *TAG = "lakehp";

static lhp_engine *s_eng;
static dhp_t *s_pipe;
static dhp_filter_t s_filters[LHP_NUM_FILTERS];
static i2s_chan_handle_t s_tx;

/* ------------------------------------------------------------------ settings */
static int load_room(void)
{
    nvs_handle_t h; uint8_t room = CONFIG_LHP_DEFAULT_ROOM;
    if (nvs_open("lakehp", NVS_READONLY, &h) == ESP_OK) { nvs_get_u8(h, "room", &room); nvs_close(h); }
    return (room >= 1 && room <= 3) ? room : CONFIG_LHP_DEFAULT_ROOM;
}
static void save_room(int room)
{
    nvs_handle_t h;
    if (nvs_open("lakehp", NVS_READWRITE, &h) == ESP_OK) { nvs_set_u8(h, "room", (uint8_t)room); nvs_commit(h); nvs_close(h); }
}

/* ------------------------------------------------------------------ USB */
void usb_audio51_on_volume(int16_t vol, bool mute) { if (s_pipe) dhp_set_usb_volume(s_pipe, vol, mute); }
void usb_audio51_on_stream(bool active) { ESP_LOGI(TAG, "USB stream %s", active ? "started" : "stopped"); }

static void usb_task(void *arg)
{
    usb_phy_config_t phy_conf = {
        .controller = USB_PHY_CTRL_OTG,
        .otg_mode = USB_OTG_MODE_DEVICE,
        .target = USB_PHY_TARGET_INT,
    };
    usb_phy_handle_t phy;
    ESP_ERROR_CHECK(usb_new_phy(&phy_conf, &phy));
    if (!tud_init(0)) { ESP_LOGE(TAG, "tud_init failed"); vTaskDelete(NULL); }

    static int16_t tmp[64 * 6];
    for (;;) {
        tud_task_ext(1, false);                 /* handle USB events, wake at least every 1 ms */
        for (;;) {                              /* pull only what the sink has drained */
            const uint32_t cap = usb_audio51_fifo_frames();
            uint32_t want = dhp_usb_frames_wanted_guarded(s_pipe, usb_audio51_frames_available(),
                                                          cap * 3 / 4, cap / 2);
            if (!want) break;
            if (want > 64) want = 64;
            uint32_t got = usb_audio51_read(tmp, want);
            if (!got) break;
            dhp_usb_write(s_pipe, tmp, got);
        }
    }
}

/* ------------------------------------------------------------------ DSP (core 1) */
static void dsp_task(void *arg)
{
    for (;;) {
        int64_t t0 = esp_timer_get_time();
        if (dhp_dsp_poll(s_pipe)) s_pipe->dsp_cycles_last = (uint32_t)(esp_timer_get_time() - t0); /* us */
        else vTaskDelay(1);
    }
}

/* ------------------------------------------------------------------ I2S out */
#if CONFIG_LHP_I2S_SLOT_16
#define SLOT_BITS I2S_DATA_BIT_WIDTH_16BIT
typedef int16_t slot_t;
#define TO_SLOT(x) (x)
#else
#define SLOT_BITS I2S_DATA_BIT_WIDTH_32BIT
typedef int32_t slot_t;
#define TO_SLOT(x) ((int32_t)(x) << 16)
#endif

static void i2s_init(void)
{
#if CONFIG_LHP_I2S_SLAVE
    /* nRF5340 drives BCLK/WS: its audio clock then paces the whole chain */
    i2s_chan_config_t cc = I2S_CHANNEL_DEFAULT_CONFIG(I2S_NUM_0, I2S_ROLE_SLAVE);
#else
    i2s_chan_config_t cc = I2S_CHANNEL_DEFAULT_CONFIG(I2S_NUM_0, I2S_ROLE_MASTER);
#endif
    cc.dma_desc_num = 4;
    cc.dma_frame_num = 120;                    /* 4 x 2.5 ms of DMA buffering */
    cc.auto_clear_after_cb = true;             /* underflow -> silence, not a repeated buffer */
    ESP_ERROR_CHECK(i2s_new_channel(&cc, &s_tx, NULL));
    i2s_std_config_t sc = {
        .clk_cfg = I2S_STD_CLK_DEFAULT_CONFIG(48000),
        .slot_cfg = I2S_STD_PHILIPS_SLOT_DEFAULT_CONFIG(SLOT_BITS, I2S_SLOT_MODE_STEREO),
        .gpio_cfg = {
            .mclk = I2S_GPIO_UNUSED,
            .bclk = CONFIG_LHP_I2S_BCLK,
            .ws = CONFIG_LHP_I2S_WS,
            .dout = CONFIG_LHP_I2S_DOUT,
            .din = I2S_GPIO_UNUSED,
            .invert_flags = { .mclk_inv = false, .bclk_inv = false, .ws_inv = false },
        },
    };
    ESP_ERROR_CHECK(i2s_channel_init_std_mode(s_tx, &sc));
    ESP_ERROR_CHECK(i2s_channel_enable(s_tx));
}

static void i2s_task(void *arg)
{
    enum { CHUNK = 120 };                      /* 2.5 ms per write */
    static int16_t pcm[CHUNK * 2];
    static slot_t out[CHUNK * 2];
    for (;;) {
        dhp_read_stereo(s_pipe, pcm, CHUNK);   /* silence-padded on underrun */
        for (int i = 0; i < CHUNK * 2; i++) out[i] = TO_SLOT(pcm[i]);
        size_t w;
        i2s_channel_write(s_tx, out, sizeof out, &w, portMAX_DELAY);  /* paced by the I2S clock */
    }
}

/* ------------------------------------------------------------------ button */
static void button_task(void *arg)
{
    gpio_config_t io = {
        .pin_bit_mask = 1ULL << CONFIG_LHP_BUTTON_GPIO,
        .mode = GPIO_MODE_INPUT,
        .pull_up_en = GPIO_PULLUP_ENABLE,
    };
    gpio_config(&io);
    bool down = false, long_fired = false;
    int64_t t_down = 0;
    for (;;) {
        vTaskDelay(pdMS_TO_TICKS(20));
        bool p = gpio_get_level(CONFIG_LHP_BUTTON_GPIO) == 0;
        int64_t now = esp_timer_get_time() / 1000;
        if (p && !down) { down = true; t_down = now; long_fired = false; }
        else if (p && down && !long_fired && now - t_down >= 2000) {
            long_fired = true;
            bool on = dhp_toggle_low_latency(s_pipe);
            ESP_LOGI(TAG, "Low-latency stereo %s", on ? "ON" : "OFF (rooms)");
        } else if (!p && down) {
            down = false;
            if (!long_fired && now - t_down >= 30) {
                int next = dhp_cycle_room(s_pipe);
                save_room(next);
                ESP_LOGI(TAG, "Room -> %s", dhp_room_name(next));
            }
        }
    }
}

/* ------------------------------------------------------------------ stats */
static void stats_task(void *arg)
{
    for (;;) {
        vTaskDelay(pdMS_TO_TICKS(5000));
        ESP_LOGI(TAG, "%s | blocks %lu | dsp %lu us/block (budget 21333) | usb_streaming %d | underruns %lu",
                 dhp_low_latency(s_pipe) ? "Low-latency stereo" : dhp_room_name(dhp_room(s_pipe)),
                 (unsigned long)s_pipe->blocks,
                 (unsigned long)s_pipe->dsp_cycles_last, usb_audio51_streaming(),
                 (unsigned long)s_pipe->out_underruns);
    }
}

void app_main(void)
{
    esp_err_t err = nvs_flash_init();
    if (err == ESP_ERR_NVS_NO_FREE_PAGES || err == ESP_ERR_NVS_NEW_VERSION_FOUND) {
        nvs_flash_erase();
        nvs_flash_init();
    }

    /* The engine is ~270 KB and is touched every block: keep it in internal RAM. */
    ESP_LOGI(TAG, "largest internal block: %u bytes, engine needs %u",
             (unsigned)heap_caps_get_largest_free_block(MALLOC_CAP_INTERNAL | MALLOC_CAP_8BIT), (unsigned)sizeof(lhp_engine));
    s_eng = heap_caps_malloc(sizeof(lhp_engine), MALLOC_CAP_INTERNAL | MALLOC_CAP_8BIT);
    if (!s_eng) {
        ESP_LOGW(TAG, "not enough internal RAM, falling back to PSRAM (slower)");
        s_eng = heap_caps_malloc(sizeof(lhp_engine), MALLOC_CAP_SPIRAM | MALLOC_CAP_8BIT);
    }
    s_pipe = heap_caps_malloc(sizeof(dhp_t), MALLOC_CAP_8BIT);
    if (!s_eng || !s_pipe) { ESP_LOGE(TAG, "out of memory"); return; }

    for (unsigned i = 0; i < LHP_NUM_FILTERS; i++)
        s_filters[i] = (dhp_filter_t){ lhp_filters[i].rate, lhp_filters[i].room,
                                       lhp_filters[i].blob, (uint32_t)lhp_filters[i].len };
    if (dhp_init(s_pipe, s_eng, s_filters, LHP_NUM_FILTERS, 48000, load_room()))
        ESP_LOGE(TAG, "no 48 kHz room filters - did extract_filters.py run?");
    ESP_LOGI(TAG, "LakeHP 5.1 ready: %s", dhp_room_name(dhp_room(s_pipe)));

    i2s_init();
    xTaskCreatePinnedToCore(dsp_task, "dsp", 6144, NULL, 10, NULL, 1);
    xTaskCreatePinnedToCore(usb_task, "usb", 4096, NULL, 12, NULL, 0);
    xTaskCreatePinnedToCore(i2s_task, "i2s", 4096, NULL, 11, NULL, 0);
    xTaskCreatePinnedToCore(button_task, "button", 3072, NULL, 3, NULL, 0);
    xTaskCreatePinnedToCore(stats_task, "stats", 3072, NULL, 1, NULL, 0);
}
