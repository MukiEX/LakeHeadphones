/*
 * LakeHP 5.1/7.1 -> Bluetooth headphone virtualizer, Raspberry Pi Pico 2 W.
 *
 *   core 0: TinyUSB (UAC2 5.1/7.1 speaker) runs from a 250 us timer interrupt.
 *           The RP2 USB driver re-arms the isochronous OUT endpoint only from
 *           tud_task(), so any gap over ~1 ms drops a USB packet (audible as
 *           fuzz); in an interrupt nothing on this core can delay it.
 *           The main loop does the sink side: SBC-encodes the Bluetooth audio
 *           (~0.45 ms per frame at 200 MHz), plus the button and LED.
 *   core 1: headphone virtualizer DSP (lakehp engine) and BTstack + CYW43 (their
 *           background IRQ is bound to the core that inits them).
 * The system clock runs at 200 MHz (RP2350 is fine there at 1.15 V); the
 * CYW43 SPI divider is scaled to keep its bus at the stock speed.
 *
 * Logging from core 0 must never block or take stdio's mutex (the main loop
 * could hold it when the USB interrupt wants it): it goes only to the
 * debug-build USB serial ring via LOG0 = dbg_logf().
 *
 * Button (BOOTSEL, or an optional GPIO button to GND):
 *   single press -> cycle Small / Medium / Large room (1/2/3 beeps + LED blinks)
 *   double press -> low-latency stereo on/off (2 high beeps = on)
 *   triple press -> USB mode: 5.1/7.1 (UAC2) <-> stereo (UAC1, for consoles such
 *                   as the Switch). Saved in flash; the Pico restarts (LED blinks 6x).
 *                   5.1 vs 7.1 is chosen on the settings page.
 *   4 presses    -> speaker placement preset: Factory <-> Theater (surrounds 136,
 *                   7.1 backs 150 deg) (1 low beep = Factory, 2 = Theater). Saved.
 *   5 presses    -> settings page network adapter on/off (restarts).
 *   hold 2 s     -> forget the paired headset and scan for a new one
 */
#include <stdio.h>
#include <stdlib.h>
#include "pico/stdlib.h"
#include "pico/multicore.h"
#include "pico/cyw43_arch.h"
#include "pico/flash.h"
#include "hardware/sync.h"
#include "hardware/irq.h"
#include "hardware/clocks.h"
#include "hardware/vreg.h"
#include "hardware/flash.h"
#include "hardware/watchdog.h"
#include <string.h>
#include "hardware/structs/ioqspi.h"
#include "hardware/structs/sio.h"
#include "tusb.h"

#include "lakehp.h"
#include "dh_pipeline.h"
#include "usb_audio51.h"
#include "bt_a2dp.h"
#if LHP_FILTERS_EMBEDDED
#include "lakehp_filters.h"      /* generated by tools/extract_filters.py */
#endif
#include "lhp_filter_region.h"
#if LHP_WEBCFG
#include "webcfg.h"
#endif

/* Without compiled-in filters, they live in flash at this offset, written
 * by tools/lakehp_flasher.html (or extract_filters.py --region). */
#define FILTER_REGION_OFFSET 0x300000u
#define FILTER_REGION_MAX    (512u * 1024u)
#if LHP_DEBUG_CDC
#include "dbg_cdc.h"
#endif

#ifndef LHP_DEFAULT_ROOM
#define LHP_DEFAULT_ROOM 1
#endif
#ifndef LHP_BUTTON_GPIO          /* -1 = use BOOTSEL */
#define LHP_BUTTON_GPIO -1
#endif
#if LHP_DEBUG_CDC
#define LOG0(...) dbg_logf(__VA_ARGS__)
#else
#define LOG0(...) do { } while (0)
#endif
#define LONG_PRESS_MS 2000
#define MULTI_GAP_MS  350        /* max gap between presses of a double/triple press */

/* ------------------------------------------------------------------ USB mode in flash */
/* One sector well below BTstack's flash bank (the last 2-3 sectors). */
#define MODE_FLASH_OFFSET (PICO_FLASH_SIZE_BYTES - 8u * FLASH_SECTOR_SIZE)
#define MODE_MAGIC        0x4D50484Cu            /* "LHPM" */
/* Stored settings. Layout (u32 words): magic, stereo, rear (v1), version,
 * surround delay/hf/eq (float bits), web off, room, low latency,
 * 7.1 (v3), back delay/hf/eq (v3). */
typedef struct {
    uint32_t stereo;
    lhp_surround_t sur;
    uint32_t web_off, room, lowlat;
    uint32_t ch8;                 /* 7.1 USB device instead of 5.1 */
    lhp_surround_t back;          /* 7.1 back pair placement */
} settings_t;
static bool placement_ok(const lhp_surround_t *s)
{
    return s->near_delay >= -12 && s->near_delay <= 24 && s->far_hf_db >= -6 && s->far_hf_db <= 12 &&
           s->back_eq >= -1 && s->back_eq <= 2;
}
static void read_placement(const volatile uint32_t *p, lhp_surround_t *s)
{
    memcpy(&s->near_delay, (const void *)&p[0], 4);
    memcpy(&s->far_hf_db, (const void *)&p[1], 4);
    memcpy(&s->back_eq, (const void *)&p[2], 4);
    if (!placement_ok(s)) *s = LHP_SURROUND_FACTORY;
}
static settings_t g_set;          /* what is stored in flash */
static void settings_load(void)
{
    const volatile uint32_t *p = (const volatile uint32_t *)(XIP_BASE + MODE_FLASH_OFFSET);
    memset(&g_set, 0, sizeof g_set);
    g_set.room = LHP_DEFAULT_ROOM;
    if (p[0] != MODE_MAGIC) return;
    g_set.stereo = p[1] == 1;
    if (p[3] == 2 || p[3] == 3) {
        read_placement(&p[4], &g_set.sur);
        g_set.web_off = p[7] == 1;
        if (p[8] >= 1 && p[8] <= 3) g_set.room = p[8];
        g_set.lowlat = p[9] == 1;
        if (p[3] == 3) {
            g_set.ch8 = p[10] == 1;
            read_placement(&p[11], &g_set.back);
        } else if (dhp_preset_of(&g_set.sur, &g_set.back) != DHP_PRESET_FACTORY) {
            lhp_surround_t s;                          /* v2 "surrounds behind" -> Theater */
            dhp_preset(DHP_PRESET_THEATER, &s, &g_set.back);
            if (!lhp_surround_equal(&s, &g_set.sur)) g_set.back = LHP_SURROUND_FACTORY;
        }
    } else if (p[2] == 1) {
        dhp_preset(DHP_PRESET_THEATER, &g_set.sur, &g_set.back);   /* v1 "rear" */
    }
}
static void settings_write_cb(void *param)
{
    static uint32_t page[FLASH_PAGE_SIZE / 4];
    const settings_t *v = param;
    memset(page, 0xFF, sizeof page);
    page[0] = MODE_MAGIC;
    page[1] = v->stereo;
    page[2] = dhp_surround_is_factory(&v->sur) ? 0 : 1;
    page[3] = 3;
    memcpy(&page[4], &v->sur.near_delay, 4);
    memcpy(&page[5], &v->sur.far_hf_db, 4);
    memcpy(&page[6], &v->sur.back_eq, 4);
    page[7] = v->web_off;
    page[8] = v->room;
    page[9] = v->lowlat;
    page[10] = v->ch8;
    memcpy(&page[11], &v->back.near_delay, 4);
    memcpy(&page[12], &v->back.far_hf_db, 4);
    memcpy(&page[13], &v->back.back_eq, 4);
    flash_range_erase(MODE_FLASH_OFFSET, FLASH_SECTOR_SIZE);
    flash_range_program(MODE_FLASH_OFFSET, (const uint8_t *)page, FLASH_PAGE_SIZE);
}
/* Pauses the other core and this core's interrupts for ~50 ms: a short
 * audible gap, so only done on an explicit button action. */
static void settings_save(void) { flash_safe_execute(settings_write_cb, &g_set, 1000); }
static uint32_t g_reboot_at;      /* ms timestamp; 0 = none pending */

static lhp_engine g_eng;
static dhp_t      g_pipe;
static dhp_filter_t g_filters[16];
static bool g_have_filters;

/* ------------------------------------------------------------------ USB glue */
static volatile uint32_t g_usb_frames;    /* frames moved from the USB FIFO into the pipeline */
void usb_audio51_on_volume(int16_t vol, bool mute)
{
    dhp_set_usb_volume(&g_pipe, vol, mute);
    LOG0("USB: volume %d.%02d dB, mute %d\n", vol / 256, (abs(vol) % 256) * 100 / 256, (int)mute);
}
/* headset buttons (AVRCP, core 1) -> USB media keys */
void bt_a2dp_media_key_cb(uint16_t usage, bool pressed) { usb_audio51_media_key(usage, pressed); }
void usb_audio51_on_stream(bool active) { (void)active; LOG0("USB: host %s the audio stream\n", active ? "opened" : "closed"); }

static void usb_pump(void)
{
    static int16_t tmp[64 * USB_AUDIO51_MAX_CHANNELS];
    for (;;) {
        const uint32_t cap = usb_audio51_fifo_frames();
        uint32_t want = dhp_usb_frames_wanted_guarded(&g_pipe, usb_audio51_frames_available(),
                                                      cap * 3 / 4, cap / 2);
        if (!want) break;
        if (want > 64) want = 64;
        uint32_t got = usb_audio51_read(tmp, want);
        if (!got) break;
        dhp_usb_write(&g_pipe, tmp, got);
        g_usb_frames += got;
    }
}

/* ------------------------------------------------------------------ core 1 */
static volatile bool g_bt_ready;          /* set by core 1 once CYW43 + BTstack are up */
/* timing stats (debug status line) */
static volatile uint32_t g_dsp_us_sum, g_dsp_n, g_dsp_us_max, g_enc_us_sum, g_enc_n, g_enc_us_max;
static volatile uint32_t g_dsp_us_total, g_enc_us_total;   /* never reset: for the settings page */
static void led_apply_core1(void);

static void core1_main(void)
{
    multicore_lockout_victim_init();       /* lets core 0 pause us for flash/BOOTSEL */
    if (cyw43_arch_init()) { printf("cyw43 init failed\n"); for (;;) tight_loop_contents(); }
    bt_a2dp_init();
    g_bt_ready = true;
    for (;;) {
        uint32_t t0 = time_us_32();
        bool did = dhp_dsp_poll(&g_pipe);
        if (did) {
            uint32_t dt = time_us_32() - t0;
            g_dsp_us_sum += dt; g_dsp_n++; g_dsp_us_total += dt;
            if (dt > g_dsp_us_max) g_dsp_us_max = dt;
        }
        led_apply_core1();
        if (!did) busy_wait_us_32(50);
    }
}

/* ------------------------------------------------------------------ sink (core 0) */
static void sink_task(void)
{
    static uint64_t vs_t0, vs_done;
    if (!g_bt_ready) return;
    if (bt_a2dp_streaming()) {
        uint32_t t0 = time_us_32();
        if (bt_a2dp_encoder_service(&g_pipe)) {
            uint32_t dt = time_us_32() - t0;
            g_enc_us_sum += dt; g_enc_n++; g_enc_us_total += dt;
            if (dt > g_enc_us_max) g_enc_us_max = dt;
        }
        vs_t0 = time_us_64(); vs_done = 0;
    } else {
        bt_a2dp_encoder_service(&g_pipe);   /* applies codec config changes */
        /* No headset streaming: drain at 48 kHz so USB timing stays sane. */
        if (!vs_t0) vs_t0 = time_us_64();
        uint64_t due = (time_us_64() - vs_t0) * 48 / 1000;
        while (due - vs_done >= 64) {
            int16_t junk[64 * 2];
            dhp_read_stereo(&g_pipe, junk, 64);
            vs_done += 64;
        }
    }
}

/* ------------------------------------------------------------------ button */
static bool __no_inline_not_in_flash_func(bootsel_raw)(void)
{
    const uint CS_PIN_INDEX = 1;
    uint32_t flags = save_and_disable_interrupts();
    hw_write_masked(&ioqspi_hw->io[CS_PIN_INDEX].ctrl,
                    GPIO_OVERRIDE_LOW << IO_QSPI_GPIO_QSPI_SS_CTRL_OEOVER_LSB,
                    IO_QSPI_GPIO_QSPI_SS_CTRL_OEOVER_BITS);
    for (volatile int i = 0; i < 1000; ++i);
#if PICO_RP2040
    const uint32_t CS_BIT = 1u << 1;
#else
    const uint32_t CS_BIT = SIO_GPIO_HI_IN_QSPI_CSN_BITS;
#endif
    bool pressed = !(sio_hw->gpio_hi_in & CS_BIT);
    hw_write_masked(&ioqspi_hw->io[CS_PIN_INDEX].ctrl,
                    GPIO_OVERRIDE_NORMAL << IO_QSPI_GPIO_QSPI_SS_CTRL_OEOVER_LSB,
                    IO_QSPI_GPIO_QSPI_SS_CTRL_OEOVER_BITS);
    restore_interrupts(flags);
    return pressed;
}

static bool button_pressed(void)
{
#if LHP_BUTTON_GPIO >= 0
    return !gpio_get(LHP_BUTTON_GPIO);
#else
    /* Flash is unusable while we sample BOOTSEL, so park core 1 first. */
    /* Lock out first, with interrupts still on: if core 1 is mid flash write
     * (BTstack storing the headset) it is locking *us* out and needs our IRQ. */
    multicore_lockout_start_blocking();
    uint32_t irq = save_and_disable_interrupts();
    bool b = bootsel_raw();
    restore_interrupts(irq);
    multicore_lockout_end_blocking();
    return b;
#endif
}

/* ------------------------------------------------------------------ LED */
static int  led_blinks;          /* pending room-change blinks */
/* The LED hangs off the CYW43, so every change is an SPI transaction that can
 * wait on the BT IRQ. Core 0 only records the wanted state; core 1 applies it. */
static volatile bool g_led_want;
static void led_set(bool on) { g_led_want = on; }
static void led_apply_core1(void)
{
    static int last = -1;
    const bool on = g_led_want;
    if (last == (int)on) return;
    last = on;
    cyw43_arch_gpio_put(CYW43_WL_GPIO_LED_PIN, on);
}

static void led_task(uint32_t now)
{
    static uint32_t t0;
    if (led_blinks) {                         /* N x (150 ms on, 150 ms off) */
        if (!t0) t0 = now;
        uint32_t ph = (now - t0) / 150;
        if (ph >= (uint32_t)led_blinks * 2 + 2) { led_blinks = 0; t0 = 0; }
        else { led_set(ph < (uint32_t)led_blinks * 2 && !(ph & 1)); return; }
    }
    switch (bt_a2dp_state()) {
    case BT_STREAMING:  led_set(true); break;                      /* solid: playing to the headset */
    case BT_CONNECTED:  led_set((now / 500) & 1); break;           /* slow blink: connected, idle   */
    case BT_SCANNING:   led_set((now / 100) & 1); break;           /* fast blink: pairing mode      */
    default:            led_set(now % 1000 < 80); break;           /* short blip each second:
                                                                      reconnecting to the remembered headset */
    }
}

static void button_task(uint32_t now)
{
    static uint32_t last_poll, down_at, released_at;
    static bool down, long_fired;
    static int clicks;
    if (g_reboot_at) return;
    if (now - last_poll < 20) return;
    last_poll = now;
    bool p = button_pressed();
    if (p && !down) { down = true; down_at = now; long_fired = false; }
    else if (p && down && !long_fired && now - down_at >= LONG_PRESS_MS) {
        long_fired = true;
        clicks = 0;
        bt_a2dp_forget_and_scan();
    } else if (!p && down) {
        down = false;
        if (!long_fired && now - down_at >= 30) { clicks++; released_at = now; }
    }
    if (!clicks || down || now - released_at <= MULTI_GAP_MS) return;
    if ((clicks < 3 || clicks == 4) && !g_have_filters) {
        led_blinks = 8;                         /* no filters: rooms unavailable */
        LOG0("No room filters loaded: add them with lakehp_flasher.html\n");
    } else if (clicks == 1) {
        int next = dhp_cycle_room(&g_pipe);
        led_blinks = next;
        LOG0("Room -> %s%s\n", dhp_room_name(next), dhp_low_latency(&g_pipe) ? " (applies when low-latency is off)" : "");
    } else if (clicks == 2) {
        bool on = dhp_toggle_low_latency(&g_pipe);
        led_blinks = on ? 4 : g_pipe.room;
        LOG0("Low-latency stereo %s\n", on ? "ON" : "OFF (rooms)");
    } else if (clicks == 3) {
        g_set.stereo = usb_audio51_is_stereo() ? 0 : 1;
        LOG0("USB mode -> %s, restarting\n", g_set.stereo ? "stereo (UAC1)" : g_set.ch8 ? "7.1 (UAC2)" : "5.1 (UAC2)");
        led_blinks = 6;
        g_reboot_at = now + 6 * 300 + 200;      /* after the blinks */
    } else if (clicks == 4) {
        lhp_surround_t sur, back;               /* 4 presses: Factory <-> Theater */
        dhp_get_placement(&g_pipe, &sur, &back);
        const int to = dhp_preset_of(&sur, &back) == DHP_PRESET_FACTORY ? DHP_PRESET_THEATER : DHP_PRESET_FACTORY;
        dhp_preset(to, &g_set.sur, &g_set.back);
        dhp_set_placement(&g_pipe, &g_set.sur, &g_set.back, true);
        settings_save();
        led_blinks = to == DHP_PRESET_THEATER ? 2 : 1;
        LOG0("Speaker placement -> %s\n", to == DHP_PRESET_THEATER ? "Theater (surrounds 136, backs 150 deg)" : "Factory");
    } else {
        g_set.web_off = !g_set.web_off;                /* 5 presses: settings adapter on/off */
        LOG0("Settings adapter -> %s, restarting\n", g_set.web_off ? "off" : "on");
        led_blinks = 5;
        g_reboot_at = now + 5 * 300 + 200;
    }
    clicks = 0;
}

static void reboot_task(uint32_t now)
{
    if (!g_reboot_at || (int32_t)(now - g_reboot_at) < 0) return;
    settings_save();
    watchdog_reboot(0, 0, 10);
    for (;;) tight_loop_contents();
}

/* ------------------------------------------------------------------ status */
#if LHP_DEBUG_CDC
static void status_task(uint32_t now)
{
    static uint32_t last, last_frames, last_blocks;
    if (now - last < 2000) return;
    const uint32_t dt = now - last;
    last = now;
    const uint32_t fr = g_usb_frames, bl = g_pipe.blocks;
    /* peak of what is queued for Bluetooth right now, as a "is it silent?" check */
    int peak = 0;
    for (uint32_t i = g_pipe.out_r; i != g_pipe.out_w && i - g_pipe.out_r < 2048; i++) {
        int v = g_pipe.out_buf[(i % DHP_OUT_FRAMES) * 2];
        if (v < 0) v = -v;
        if (v > peak) peak = v;
    }
    static uint32_t last_rx, last_fb;
    uint32_t rxp, rxb, fbp;
    usb_audio51_debug_counters(&rxp, &rxb, &fbp);
    LOG0("[%lu s] usb pkts: rx %lu/s (%lu bytes total), feedback %lu/s\n", (unsigned long)(now / 1000),
           (unsigned long)((rxp - last_rx) * 1000u / dt), (unsigned long)rxb, (unsigned long)((fbp - last_fb) * 1000u / dt));
    last_rx = rxp; last_fb = fbp;
    if (usb_audio51_is_stereo()) {
        uint32_t dr, du, ov;
        usb_audio51_stereo_counters(&dr, &du, &ov);
        LOG0("[%lu s] stereo mode (UAC1): drift drops %lu, repeats %lu, ring overflows %lu\n",
             (unsigned long)(now / 1000), (unsigned long)dr, (unsigned long)du, (unsigned long)ov);
    }
    LOG0("[%lu s] usb: %s, %lu frames/s, fifo %lu | dsp: %lu blocks/s, room %d, LL %d, gain %d/1000, mute %d, "
           "in-ovr %lu, out-under %lu, out queued %lu (peak %d)\n",
           (unsigned long)(now / 1000), usb_audio51_streaming() ? "streaming" : "idle",
           (unsigned long)((fr - last_frames) * 1000u / dt), (unsigned long)usb_audio51_frames_available(),
           (unsigned long)((bl - last_blocks) * 1000u / dt), g_pipe.room, (int)dhp_low_latency(&g_pipe),
           (int)(g_pipe.gain * 1000.0f), (int)g_pipe.mute, (unsigned long)g_pipe.in_overruns,
           (unsigned long)g_pipe.out_underruns, (unsigned long)dhp_out_available(&g_pipe), peak);
    bt_a2dp_debug_print(dbg_logf);
    {
        uint32_t dn = g_dsp_n, ds = g_dsp_us_sum, dm = g_dsp_us_max, en = g_enc_n, es = g_enc_us_sum, em = g_enc_us_max;
        g_dsp_n = g_dsp_us_sum = g_dsp_us_max = g_enc_n = g_enc_us_sum = g_enc_us_max = 0;
        LOG0("  load: dsp %lu us/block avg (max %lu) = core1 %lu%%, sbc %lu us/frame avg (max %lu) = core0 %lu%%\n",
               (unsigned long)(dn ? ds / dn : 0), (unsigned long)dm, (unsigned long)(ds / (dt * 10u)),
               (unsigned long)(en ? es / en : 0), (unsigned long)em, (unsigned long)(es / (dt * 10u)));
    }
    last_frames = fr; last_blocks = bl;
}
#endif

/* ------------------------------------------------------------------ USB service (timer IRQ) */
/* Everything that touches TinyUSB lives here, so it all runs in one context. */
static bool usb_service_cb(repeating_timer_t *t)
{
    (void)t;
    tud_task();
    usb_pump();
    usb_audio51_service();                    /* media keys from the headset */
#if LHP_WEBCFG
    if (usb_audio51_has_network()) webcfg_usb_service();
#endif
#if LHP_DEBUG_CDC
    dbg_cdc_task();
#endif
    return true;
}

/* Runs right after TinyUSB's own USB interrupt handler (same IRQ, lowest
 * order), so a finished isochronous packet is re-armed within microseconds.
 * Waiting for the 250 us timer was usually fine, but when the host happened to
 * send two packets close together (end of one frame, start of the next) the
 * second one found the endpoint unarmed and was lost: a click. The timer and
 * this handler share one priority, so tud_task() never runs nested. */
static void usb_irq_task(void) { tud_task(); }

/* ------------------------------------------------------------------ settings page */
#if LHP_WEBCFG
#ifndef LHP_FW_VERSION
#define LHP_FW_VERSION "2026.10"
#endif
static void web_state(char *b, int max)
{
    static uint32_t last_ms, last_dsp, last_enc, last_rx, rx_rate;
    const uint32_t now = to_ms_since_boot(get_absolute_time()), dt = now - last_ms ? now - last_ms : 1;
    const uint32_t dsp = g_dsp_us_total, enc = g_enc_us_total;
    uint32_t rxp, rxb, fbp;
    usb_audio51_debug_counters(&rxp, &rxb, &fbp);
    int dsp_pct = (int)((dsp - last_dsp) / (dt * 10u)), enc_pct = (int)((enc - last_enc) / (dt * 10u));
    if (dt > 200) { rx_rate = (rxp - last_rx) * 1000u / dt; last_ms = now; last_dsp = dsp; last_enc = enc; last_rx = rxp; }
    lhp_surround_t s, k;
    dhp_get_placement(&g_pipe, &s, &k);
    char addr[20]; int rate, bitpool;
    bt_a2dp_peer_info(addr, &rate, &bitpool);
    const char *arr = usb_audio51_is_stereo() ? "stereo" : usb_audio51_channels() == 8 ? "71" : "51";
    const char *saved_arr = g_set.stereo ? "stereo" : g_set.ch8 ? "71" : "51";
    snprintf(b, max,
        "{\"fw\":\"%s\",\"arr\":\"%s\",\"stereo\":%s,\"filters\":%s,\"room\":%d,\"lowlat\":%s,"
        "\"preset\":\"%s\","
        "\"sur\":{\"delay\":%.2f,\"hf\":%.2f,\"eq\":%.2f,\"az\":%.1f},"
        "\"back\":{\"delay\":%.2f,\"hf\":%.2f,\"eq\":%.2f,\"az\":%.1f},"
        "\"saved\":{\"arr\":\"%s\",\"preset\":\"%s\",\"room\":%u,\"lowlat\":%s},"
        "\"usb\":{\"stream\":%s,\"rx\":%lu},\"bt\":{\"state\":%d,\"addr\":\"%s\",\"rate\":%d,\"bitpool\":%d},"
        "\"load\":{\"dsp\":%d,\"enc\":%d}}",
        LHP_FW_VERSION, arr, usb_audio51_is_stereo() ? "true" : "false", g_have_filters ? "true" : "false",
        dhp_room(&g_pipe), dhp_low_latency(&g_pipe) ? "true" : "false",
        dhp_preset_name(dhp_preset_of(&s, &k)),
        (double)s.near_delay, (double)s.far_hf_db, (double)s.back_eq, (double)lhp_surround_azimuth(&s),
        (double)k.near_delay, (double)k.far_hf_db, (double)k.back_eq, (double)lhp_surround_azimuth(&k),
        saved_arr, dhp_preset_name(dhp_preset_of(&g_set.sur, &g_set.back)),
        (unsigned)g_set.room, g_set.lowlat ? "true" : "false",
        usb_audio51_streaming() ? "true" : "false", (unsigned long)rx_rate,
        (int)bt_a2dp_state(), addr, rate, bitpool, dsp_pct > 100 ? 100 : dsp_pct, enc_pct > 100 ? 100 : enc_pct);
}

static float clampf(float v, float lo, float hi) { return v < lo ? lo : v > hi ? hi : v; }
/* "<prefix>delay/hf/eq" fine-tune values and "<prefix>az" angle for one pair */
static bool apply_pair(const char *body, const char *prefix, lhp_surround_t *s)
{
    char key[12];
    float v;
    bool any = false;
    snprintf(key, sizeof key, "%saz", prefix);
    if (webcfg_json_num(body, key, &v)) { *s = lhp_surround_for_azimuth(v); any = true; }
    snprintf(key, sizeof key, "%sdelay", prefix);
    if (webcfg_json_num(body, key, &v)) { s->near_delay = clampf(v, -12, 24); any = true; }
    snprintf(key, sizeof key, "%shf", prefix);
    if (webcfg_json_num(body, key, &v)) { s->far_hf_db = clampf(v, -6, 12); any = true; }
    snprintf(key, sizeof key, "%seq", prefix);
    if (webcfg_json_num(body, key, &v)) { s->back_eq = clampf(v, -1, 2); any = true; }
    return any;
}

static void web_apply(const char *body, char *resp, int max)
{
    float v;
    char str[24];
    const char *msg = "ok";
    if (g_have_filters) {
        if (webcfg_json_num(body, "room", &v) && v >= 1 && v <= 3) dhp_request_room(&g_pipe, (int)v);
        if (webcfg_json_num(body, "lowlat", &v)) dhp_set_low_latency(&g_pipe, v != 0);
        lhp_surround_t s, k;
        dhp_get_placement(&g_pipe, &s, &k);
        bool moved = apply_pair(body, "", &s);
        moved |= apply_pair(body, "b", &k);
        if (webcfg_json_str(body, "preset", str, sizeof str)) {
            dhp_preset(!strcmp(str, "theater") ? DHP_PRESET_THEATER : DHP_PRESET_FACTORY, &s, &k);
            moved = true;
        }
        if (moved) dhp_set_placement(&g_pipe, &s, &k, false);
    }
    if (webcfg_json_str(body, "arr", str, sizeof str)) {
        const uint32_t stereo = !strcmp(str, "stereo"), ch8 = !strcmp(str, "71");
        const char *cur = usb_audio51_is_stereo() ? "stereo" : usb_audio51_channels() == 8 ? "71" : "51";
        if (strcmp(str, cur) && (stereo || ch8 || !strcmp(str, "51"))) {
            g_set.stereo = stereo;
            if (!stereo) g_set.ch8 = ch8;
            g_reboot_at = to_ms_since_boot(get_absolute_time()) + 500;
            msg = stereo ? "Restarting as a stereo device" : ch8 ? "Restarting as a 7.1 device" : "Restarting as a 5.1 device";
        }
    }
    if (webcfg_json_str(body, "action", str, sizeof str)) {
        if (!strcmp(str, "save")) {
            dhp_get_placement(&g_pipe, &g_set.sur, &g_set.back);
            g_set.room = (uint32_t)dhp_room(&g_pipe);
            g_set.lowlat = dhp_low_latency(&g_pipe);
            settings_save();
            msg = "Saved";
        } else if (!strcmp(str, "revert")) {
            dhp_set_placement(&g_pipe, &g_set.sur, &g_set.back, false);
        } else if (!strcmp(str, "forget")) {
            bt_a2dp_forget_and_scan();
            msg = "Pairing mode";
        } else if (!strcmp(str, "weboff")) {
            g_set.web_off = 1;
            g_reboot_at = to_ms_since_boot(get_absolute_time()) + 500;
        } else if (!strcmp(str, "reboot")) {
            g_reboot_at = to_ms_since_boot(get_absolute_time()) + 500;
        }
    }
    snprintf(resp, max, "{\"ok\":true,\"msg\":\"%s\"}", msg);
}
static const webcfg_hooks_t s_web_hooks = { web_state, web_apply };
#endif

/* ------------------------------------------------------------------ main */
int main(void)
{
    vreg_set_voltage(VREG_VOLTAGE_1_15);
    sleep_ms(2);
    set_sys_clock_khz(200000, true);
    stdio_init_all();                         /* UART0 on GP0/GP1 for logs */
#if LHP_DEBUG_CDC
    dbg_cdc_init();                           /* + the USB serial port */
#endif
#if LHP_BUTTON_GPIO >= 0
    gpio_init(LHP_BUTTON_GPIO);
    gpio_pull_up(LHP_BUTTON_GPIO);
#endif
    settings_load();
    int nfilt;
#if LHP_FILTERS_EMBEDDED
    nfilt = (int)LHP_NUM_FILTERS;
    for (int i = 0; i < nfilt && i < 16; i++)
        g_filters[i] = (dhp_filter_t){ lhp_filters[i].rate, lhp_filters[i].room,
                                       lhp_filters[i].blob, (uint32_t)lhp_filters[i].len };
#else
    nfilt = lhp_region_parse((const uint8_t *)(XIP_BASE + FILTER_REGION_OFFSET), FILTER_REGION_MAX, g_filters, 16);
    if (nfilt < 0) {
        printf("No room filters in flash (code %d): add them with tools/lakehp_flasher.html\n", nfilt);
        nfilt = 0;
    }
#endif
    g_have_filters = dhp_init(&g_pipe, &g_eng, g_filters, nfilt, 48000, (int)g_set.room) == 0;
    if (!g_have_filters) {
        /* Still a working stereo downmix, just without the rooms. */
        g_pipe.lowlat = true;
        led_blinks = 8;
        printf("WARNING: no 48 kHz room filters - running as plain low-latency stereo\n");
    }
    if (g_have_filters) {
        if (!g_set.stereo && g_set.ch8) {
            lhp_set_surround(&g_eng, &g_set.sur);     /* placed once, by the 7.1 reload below */
            lhp_set_back(&g_eng, &g_set.back);
            g_pipe.sur = g_pipe.sur_req = g_set.sur;
            g_pipe.back = g_pipe.back_req = g_set.back;
            dhp_set_channels(&g_pipe, 8);
        } else if (dhp_preset_of(&g_set.sur, &g_set.back) != DHP_PRESET_FACTORY) {
            dhp_set_placement_now(&g_pipe, &g_set.sur, &g_set.back);
        }
        if (g_set.lowlat) g_pipe.lowlat = true;
    } else if (!g_set.stereo && g_set.ch8) {
        dhp_set_channels(&g_pipe, 8);                 /* low-latency downmix still takes 7.1 */
    }
    printf("LakeHP 5.1: %s, %d filters, engine %u bytes\n", g_have_filters ? dhp_room_name(g_pipe.room) : "no rooms",
           nfilt, (unsigned)sizeof g_eng);

    flash_safe_execute_core_init();           /* core 1 (BTstack) may write flash: let it pause us */
    static uint32_t core1_stack[4096];        /* 16 KB: DSP + SBC + BTstack/CYW43 IRQ work */
    multicore_launch_core1_with_stack(core1_main, core1_stack, sizeof core1_stack);

    const bool stereo = g_set.stereo;
    usb_audio51_set_stereo(stereo);
    usb_audio51_set_channels(!stereo && g_set.ch8 ? 8 : 6);
#if LHP_WEBCFG
    const bool web = !stereo && !g_set.web_off;
    usb_audio51_set_network(web);
    if (web) webcfg_init(&s_web_hooks);
#endif
    g_pipe.stereo_input = stereo;
    printf("USB mode: %s\n", stereo ? "stereo (UAC1)" : g_set.ch8 ? "7.1 (UAC2)" : "5.1 (UAC2)");
    tud_init(0);                              /* device stack on root port 0 */
    static repeating_timer_t usb_timer;
    add_repeating_timer_us(-250, usb_service_cb, NULL, &usb_timer);
    irq_add_shared_handler(USBCTRL_IRQ, usb_irq_task, PICO_SHARED_IRQ_HANDLER_LOWEST_ORDER_PRIORITY);

    for (;;) {
        uint32_t now = to_ms_since_boot(get_absolute_time());
        button_task(now);
        led_task(now);
        sink_task();
        reboot_task(now);
#if LHP_WEBCFG
        if (web) webcfg_poll();
#endif
#if LHP_DEBUG_CDC
        status_task(now);                     /* main loop: its formatting can't delay USB */
#endif
    }
}
